## archdt.its
```
/dts-v1/;
// Same layout as the Arch Linux ARM oak kernel FIT that boots on this Chromebook; only the kernel is ours.
/ {
    description = "Chrome OS kernel image with one or more FDT blobs";
    #address-cells = <1>;
    images {
        kernel@1 {
            description = "kernel";
            data = /incbin/("Image");
            type = "kernel_noload";
            arch = "arm64";
            os = "linux";
            compression = "none";
            load = <0>;
            entry = <0>;
        };
        fdt@1 {
            description = "mt8173-elm-rev0.dtb";
            data = /incbin/("archdt/fdt1.dtb");
            type = "flat_dt";
            arch = "arm64";
            compression = "none";
            hash@1 { algo = "sha1"; };
        };
        fdt@2 {
            description = "mt8173-elm-rev1.dtb";
            data = /incbin/("archdt/fdt2.dtb");
            type = "flat_dt";
            arch = "arm64";
            compression = "none";
            hash@1 { algo = "sha1"; };
        };
        fdt@3 {
            description = "mt8173-elm-rev3.dtb";
            data = /incbin/("archdt/fdt3.dtb");
            type = "flat_dt";
            arch = "arm64";
            compression = "none";
            hash@1 { algo = "sha1"; };
        };
        fdt@4 {
            description = "mt8173-hana-rev0.dtb";
            data = /incbin/("archdt/fdt4.dtb");
            type = "flat_dt";
            arch = "arm64";
            compression = "none";
            hash@1 { algo = "sha1"; };
        };
        fdt@5 {
            description = "mt8173-oak-rev2.dtb";
            data = /incbin/("archdt/fdt5.dtb");
            type = "flat_dt";
            arch = "arm64";
            compression = "none";
            hash@1 { algo = "sha1"; };
        };
        fdt@6 {
            description = "mt8173-oak-rev3.dtb";
            data = /incbin/("archdt/fdt6.dtb");
            type = "flat_dt";
            arch = "arm64";
            compression = "none";
            hash@1 { algo = "sha1"; };
        };
        fdt@7 {
            description = "mt8173-oak-rev4.dtb";
            data = /incbin/("archdt/fdt7.dtb");
            type = "flat_dt";
            arch = "arm64";
            compression = "none";
            hash@1 { algo = "sha1"; };
        };
        fdt@8 {
            description = "mt8173-oak-rev5.dtb";
            data = /incbin/("archdt/fdt8.dtb");
            type = "flat_dt";
            arch = "arm64";
            compression = "none";
            hash@1 { algo = "sha1"; };
        };
        fdt@9 {
            description = "mt8173-oak-rev6.dtb";
            data = /incbin/("archdt/fdt9.dtb");
            type = "flat_dt";
            arch = "arm64";
            compression = "none";
            hash@1 { algo = "sha1"; };
        };
    };
    configurations {
        default = "conf@1";
        conf@1 { kernel = "kernel@1"; fdt = "fdt@1"; };
        conf@2 { kernel = "kernel@1"; fdt = "fdt@2"; };
        conf@3 { kernel = "kernel@1"; fdt = "fdt@3"; };
        conf@4 { kernel = "kernel@1"; fdt = "fdt@4"; };
        conf@5 { kernel = "kernel@1"; fdt = "fdt@5"; };
        conf@6 { kernel = "kernel@1"; fdt = "fdt@6"; };
        conf@7 { kernel = "kernel@1"; fdt = "fdt@7"; };
        conf@8 { kernel = "kernel@1"; fdt = "fdt@8"; };
        conf@9 { kernel = "kernel@1"; fdt = "fdt@9"; };
    };
};
```

## hana.its
```
/dts-v1/;
/ {
    description = "custom OS for hana";
    #address-cells = <1>;
    images {
        kernel-1 {
            description = "kernel";
            data = /incbin/("Image");
            type = "kernel";
            arch = "arm64";
            os = "linux";
            compression = "none";
            load = <0>;
            entry = <0>;
            hash-1 { algo = "sha1"; };
        };
        fdt-1 {
            description = "mt8173-elm-hana";
            data = /incbin/("mt8173-elm-hana.dtb");
            type = "flat_dt";
            arch = "arm64";
            compression = "none";
            hash-1 { algo = "sha1"; };
        };
    };
    configurations {
        default = "conf-1";
        conf-1 { description = "hana"; kernel = "kernel-1"; fdt = "fdt-1"; };
    };
};
```
